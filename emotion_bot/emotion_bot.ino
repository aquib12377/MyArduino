// ============================================================
//  Emotion Bot — ESP32-S3 N16R8
//  Bluetooth: BLE via NimBLE-Arduino (UART service emulation)
//
//  Hardware:
//    WS2812 #1  → GPIO 4   (10 LEDs, left eye)
//    WS2812 #2  → GPIO 5   (10 LEDs, right eye)
//    MAX98357A  → GPIO 11 (BCLK), 12 (LRCLK), 13 (DIN)
//    Servo 1    → GPIO 15  (left arm)
//    Servo 2    → GPIO 16  (right arm)
//    SD card    ← NOT USED (audio embedded in flash)
//
//  Library dependencies (Arduino Library Manager):
//    - NimBLE-Arduino   (by h2zero)
//    - FastLED          (by Daniel Garcia)
//    - ESP32Servo       (by Kevin Harrington)
//    - ESP8266Audio     (by Earle Philhower)   WAV + I2S playback
//
//  ── AUDIO NOTE ───────────────────────────────────────────────
//  Audio is embedded directly in flash as PROGMEM byte arrays
//  (generated by wav_to_header.py from your WAV files).
//  No SD card is needed. This eliminates the SPI bottleneck
//  that caused distorted playback at 400 kHz SPI.
//
//  WHY SD WAS DISTORTED:
//    44100 Hz × 16-bit × 1ch = 88 200 B/s required
//    SPI @ 400 kHz (≈60% eff.) = only 30 000 B/s available
//    → buffer starvation → choppy, distorted audio
//
//  ── PARTITION SCHEME ─────────────────────────────────────────
//  In Arduino IDE:
//    Tools → Partition Scheme → "Huge APP (3MB No OTA/1MB SPIFFS)"
//  This gives a 3 MB app partition; your audio data is ~810 KB
//  so the full firmware+audio fits comfortably.
//
//  ── BLE UART SERVICE (Nordic NUS) ────────────────────────────
//  Commands (plain text, newline-terminated):
//    HAPPY | SAD | ANGRY | SURPRISE | CALM | FEAR | DISGUST
// ============================================================

#include <Arduino.h>
#include <NimBLEDevice.h>
#include <FastLED.h>
#include <ESP32Servo.h>
#include <AudioFileSourcePROGMEM.h>   // ← replaces AudioFileSourceSD
#include <AudioOutputI2S.h>
#include <AudioGeneratorWAV.h>
#include "emotion_audio.h"             // ← generated by wav_to_header.py

// ─────────────────────────────────────────────────────────────
//  PIN DEFINITIONS
// ─────────────────────────────────────────────────────────────
#define LED_PIN_1   4
#define LED_PIN_2   5
#define NUM_LEDS    10

#define I2S_BCLK    11
#define I2S_LRCLK   12
#define I2S_DIN     13

#define SERVO1_PIN  15
#define SERVO2_PIN  16

// ─────────────────────────────────────────────────────────────
//  BLE — Nordic UART Service (NUS) UUIDs
// ─────────────────────────────────────────────────────────────
#define NUS_SERVICE_UUID  "6E400001-B5A3-F393-E0A9-E50E24DCCA9E"
#define NUS_RX_UUID       "6E400002-B5A3-F393-E0A9-E50E24DCCA9E"
#define NUS_TX_UUID       "6E400003-B5A3-F393-E0A9-E50E24DCCA9E"

// ─────────────────────────────────────────────────────────────
//  GLOBAL OBJECTS
// ─────────────────────────────────────────────────────────────
CRGB leds1[NUM_LEDS];
CRGB leds2[NUM_LEDS];

Servo servo1;
Servo servo2;

NimBLEServer         *pServer  = nullptr;
NimBLECharacteristic *pTxChar  = nullptr;
bool bleConnected = false;

// Audio — PROGMEM source instead of SD source
AudioGeneratorWAV      *wav  = nullptr;
AudioFileSourcePROGMEM *file = nullptr;   // ← changed type
AudioOutputI2S         *out  = nullptr;

// Pending emotion flag (set in BLE callback, consumed in loop)
volatile bool    newEmotionPending = false;
volatile uint8_t pendingEmotion    = 0;

// ─────────────────────────────────────────────────────────────
//  EMOTION DEFINITIONS
// ─────────────────────────────────────────────────────────────
enum Emotion : uint8_t {
  EMO_NONE = 0,
  EMO_HAPPY, EMO_SAD, EMO_ANGRY, EMO_SURPRISE, EMO_CALM, EMO_FEAR, EMO_DISGUST,
  EMO_NEUTRAL
};

struct EmotionConfig {
  CRGB            color;
  uint8_t         brightness;
  const uint8_t  *audioData;   // PROGMEM pointer (nullptr = silent)
  uint32_t        audioLen;
};

// Audio arrays come from emotion_audio.h (PROGMEM, 16 kHz/16-bit/mono)
const EmotionConfig emotionTable[] = {
  /* NONE     */ { CRGB::Black,          0,   nullptr,      0              },
  /* HAPPY    */ { CRGB::Yellow,         255, HAPPY_WAV,    HAPPY_WAV_LEN  },
  /* SAD      */ { CRGB::Blue,           255, SAD_WAV,      SAD_WAV_LEN    },
  /* ANGRY    */ { CRGB::Red,            255, ANGRY_WAV,    ANGRY_WAV_LEN  },
  /* SURPRISE */ { CRGB::White,          255, NEUTRAL_WAV,  NEUTRAL_WAV_LEN},
  /* CALM     */ { CRGB(0,   200, 100),  120, nullptr,      0              },
  /* FEAR     */ { CRGB(180, 0,   180),  160, nullptr,      0              },
  /* DISGUST  */ { CRGB(80,  180, 0),    160, nullptr,      0              },
  /* NEUTRAL  */ { CRGB(150, 150, 150),  180, NEUTRAL_WAV,  NEUTRAL_WAV_LEN}
};

const int SERVO_REST_POS  = 90;
const int SERVO_HUG_POS_1 = 30;
const int SERVO_HUG_POS_2 = 150;

// ─────────────────────────────────────────────────────────────
//  BLE SERVER CALLBACKS
// ─────────────────────────────────────────────────────────────
class ServerCallbacks : public NimBLEServerCallbacks {
  void onConnect(NimBLEServer *pSvr, NimBLEConnInfo &connInfo) override {
    bleConnected = true;
    Serial.println("[BLE] Client connected.");
    NimBLEDevice::startAdvertising();
  }
  void onDisconnect(NimBLEServer *pServer, NimBLEConnInfo &connInfo, int reason) override {
    bleConnected = false;
    Serial.println("[BLE] Client disconnected — restarting advertising.");
    NimBLEDevice::startAdvertising();
  }
};

// ─────────────────────────────────────────────────────────────
//  BLE RX CALLBACK  (runs on BLE stack task — keep it short)
// ─────────────────────────────────────────────────────────────
class RxCallbacks : public NimBLECharacteristicCallbacks {
  void onWrite(NimBLECharacteristic *pChar, NimBLEConnInfo &connInfo) override {
    std::string raw = pChar->getValue();
    String cmd = String(raw.c_str());
    cmd.trim();
    cmd.toUpperCase();
    Serial.printf("[BLE RX] '%s'\n", cmd.c_str());

    uint8_t emo = EMO_NONE;
    if      (cmd == "HAPPY")    emo = EMO_HAPPY;
    else if (cmd == "SAD")      emo = EMO_SAD;
    else if (cmd == "ANGRY")    emo = EMO_ANGRY;
    else if (cmd == "SURPRISE") emo = EMO_SURPRISE;
    else if (cmd == "CALM")     emo = EMO_CALM;
    else if (cmd == "FEAR")     emo = EMO_FEAR;
    else if (cmd == "DISGUST")  emo = EMO_DISGUST;
    else if (cmd == "NEUTRAL")  emo = EMO_NEUTRAL;   // ← add

    if (emo != EMO_NONE) {
      pendingEmotion    = emo;
      newEmotionPending = true;
    } else {
      if (pTxChar) {
        pTxChar->setValue("ERR: try HAPPY SAD ANGRY SURPRISE CALM FEAR DISGUST");
        pTxChar->notify();
      }
    }
  }
};

// ─────────────────────────────────────────────────────────────
//  AUDIO HELPERS
// ─────────────────────────────────────────────────────────────
void stopAudio() {
  if (wav && wav->isRunning()) wav->stop();
  if (wav)  { delete wav;  wav  = nullptr; }
  if (file) { delete file; file = nullptr; }
}

// Play audio from a PROGMEM byte array (full WAV file in flash)
void playSound(const uint8_t *data, uint32_t len) {
  if (!data || len == 0) {
    Serial.println("[Audio] No audio data for this emotion.");
    return;
  }
  stopAudio();

  // AudioFileSourcePROGMEM reads directly from flash — no SD, no SPI
  file = new AudioFileSourcePROGMEM(data, len);
  if (!file) {
    Serial.println("[Audio] PROGMEM source alloc failed.");
    return;
  }
  wav = new AudioGeneratorWAV();
  if (!wav->begin(file, out)) {
    Serial.println("[Audio] WAV begin() failed.");
    stopAudio();
  }
}

// ─────────────────────────────────────────────────────────────
//  LED HELPERS
// ─────────────────────────────────────────────────────────────
void setLEDs(CRGB color, uint8_t brightness) {
  FastLED.setBrightness(brightness);
  fill_solid(leds1, NUM_LEDS, color);
  fill_solid(leds2, NUM_LEDS, color);
  FastLED.show();
}

// Breathing blue for SAD  (non-blocking version would be cleaner,
// but kept blocking here to match the original design)
void sadLEDEffect(unsigned long durationMs) {
  unsigned long start = millis();
  while (millis() - start < durationMs) {
    for (int b = 20; b <= 120; b += 2) {
      FastLED.setBrightness(b);
      fill_solid(leds1, NUM_LEDS, CRGB::Blue);
      fill_solid(leds2, NUM_LEDS, CRGB::Blue);
      FastLED.show();
      delay(12);
    }
    for (int b = 120; b >= 20; b -= 2) {
      FastLED.setBrightness(b);
      FastLED.show();
      delay(12);
    }
  }
}

// ─────────────────────────────────────────────────────────────
//  SERVO HELPERS
// ─────────────────────────────────────────────────────────────
void performHug() {
  int cur1  = servo1.read();
  int cur2  = servo2.read();
  int range = max(abs(SERVO_HUG_POS_1 - cur1), abs(SERVO_HUG_POS_2 - cur2));

  for (int i = 0; i <= range; i++) {
    float t = (float)i / (float)range;
    servo1.write(cur1 + (int)((SERVO_HUG_POS_1 - cur1) * t));
    servo2.write(cur2 + (int)((SERVO_HUG_POS_2 - cur2) * t));
    delay(15);
  }
  delay(2000);

  range = max(abs(SERVO_REST_POS - SERVO_HUG_POS_1),
              abs(SERVO_REST_POS - SERVO_HUG_POS_2));
  for (int i = 0; i <= range; i++) {
    float t = (float)i / (float)range;
    servo1.write(SERVO_HUG_POS_1 + (int)((SERVO_REST_POS - SERVO_HUG_POS_1) * t));
    servo2.write(SERVO_HUG_POS_2 + (int)((SERVO_REST_POS - SERVO_HUG_POS_2) * t));
    delay(15);
  }
}

// ─────────────────────────────────────────────────────────────
//  EMOTION DISPATCHER
// ─────────────────────────────────────────────────────────────
void applyEmotion(uint8_t emo) {
  if (emo == EMO_NONE) return;
  const EmotionConfig &cfg = emotionTable[emo];

const char *names[] = { "NONE","HAPPY","SAD","ANGRY","SURPRISE","CALM","FEAR","DISGUST","NEUTRAL" };
  Serial.printf("[Emotion] %s  brightness=%d  audio=%s\n",
                names[emo], cfg.brightness,
                cfg.audioData ? "PROGMEM" : "none");

  // ACK over BLE TX
  if (pTxChar && bleConnected) {
    String ack = String("OK: ") + names[emo];
    pTxChar->setValue(ack.c_str());
    pTxChar->notify();
  }

  // 1. LEDs
  setLEDs(cfg.color, cfg.brightness);

  // 2. Audio (from PROGMEM — no SD, no SPI delay)
  playSound(cfg.audioData, cfg.audioLen);

  // 3. SAD → hug + breathing LEDs
  if (emo == EMO_SAD) {
    // Block here and drain the WAV decoder so the full clip
    // plays before the servo movement starts.
    while (wav && wav->isRunning()) {
      if (!wav->loop()) {
        wav->stop();
        break;
      }
    }
    performHug();
    sadLEDEffect(3000);
  }
}

// ─────────────────────────────────────────────────────────────
//  SETUP
// ─────────────────────────────────────────────────────────────
void setup() {
  Serial.begin(115200);
  unsigned long t0 = millis();
  while (!Serial && (millis() - t0 < 3000)) { delay(10); }
  delay(500);
  Serial.println("\n[Boot] EmotionBot starting...");
  Serial.printf("[Boot] Free heap : %d bytes\n", ESP.getFreeHeap());
  Serial.printf("[Boot] CPU freq  : %d MHz\n",   ESP.getCpuFreqMHz());

  // ── FastLED ──────────────────────────────────────────────
  FastLED.addLeds<WS2812B, LED_PIN_1, GRB>(leds1, NUM_LEDS).setCorrection(TypicalSMD5050);
  FastLED.addLeds<WS2812B, LED_PIN_2, GRB>(leds2, NUM_LEDS).setCorrection(TypicalSMD5050);
  FastLED.setBrightness(0);
  FastLED.show();
  Serial.println("[Boot] LEDs OK.");

  // ── Servos ───────────────────────────────────────────────
  ESP32PWM::allocateTimer(0);
  ESP32PWM::allocateTimer(1);
  servo1.setPeriodHertz(50);
  servo2.setPeriodHertz(50);
  servo1.attach(SERVO1_PIN, 500, 2400);
  servo2.attach(SERVO2_PIN, 500, 2400);
  servo1.write(SERVO_REST_POS);
  servo2.write(SERVO_REST_POS);
  Serial.println("[Boot] Servos OK.");

  // ── I2S / MAX98357A ──────────────────────────────────────
  // AudioOutputI2S reads WAV sample-rate from the header and
  // auto-configures the I2S peripheral — no manual rate needed.
  out = new AudioOutputI2S();
  out->SetPinout(I2S_BCLK, I2S_LRCLK, I2S_DIN);
  out->SetGain(3.0f);   // ← was 0.8 → reduced to prevent clipping
  Serial.println("[Boot] I2S OK.");

  // ── NimBLE ───────────────────────────────────────────────
  Serial.printf("[Boot] Free heap before BLE : %d bytes\n", ESP.getFreeHeap());
  NimBLEDevice::init("EmotionBot");
  NimBLEDevice::setPower(3);

  pServer = NimBLEDevice::createServer();
  pServer->setCallbacks(new ServerCallbacks());

  NimBLEService *pService = pServer->createService(NUS_SERVICE_UUID);

  pTxChar = pService->createCharacteristic(NUS_TX_UUID, NIMBLE_PROPERTY::NOTIFY);

  NimBLECharacteristic *pRxChar = pService->createCharacteristic(
      NUS_RX_UUID, NIMBLE_PROPERTY::WRITE | NIMBLE_PROPERTY::WRITE_NR);
  pRxChar->setCallbacks(new RxCallbacks());

  pService->start();

  NimBLEAdvertising *pAdv = NimBLEDevice::getAdvertising();
  pAdv->addServiceUUID(NUS_SERVICE_UUID);
  pAdv->enableScanResponse(true);
  pAdv->setName("EmotionBot");
  pAdv->start();
  Serial.println("[Boot] BLE advertising as 'EmotionBot'.");
  Serial.printf("[Boot] Free heap after BLE  : %d bytes\n", ESP.getFreeHeap());

  // ── Startup LED sweep ────────────────────────────────────
  FastLED.setBrightness(80);
  for (int i = 0; i < NUM_LEDS; i++) {
    leds1[i] = CRGB::White;
    leds2[i] = CRGB::White;
    FastLED.show();
    delay(40);
  }
  delay(300);
  fill_solid(leds1, NUM_LEDS, CRGB::Black);
  fill_solid(leds2, NUM_LEDS, CRGB::Black);
  FastLED.show();

Serial.println("[Boot] Ready. Commands: HAPPY SAD ANGRY SURPRISE CALM FEAR DISGUST NEUTRAL");
}

// ─────────────────────────────────────────────────────────────
//  LOOP
// ─────────────────────────────────────────────────────────────
void loop() {
  // Pump the WAV decoder — must be called every loop iteration
  if (wav && wav->isRunning()) {
    if (!wav->loop()) {
      wav->stop();
      Serial.println("[Audio] Playback done.");
    }
  }

  // Consume pending BLE command
  if (newEmotionPending) {
    newEmotionPending = false;
    applyEmotion(pendingEmotion);
  }

  // USB Serial debug interface
  if (Serial.available()) {
    String cmd = Serial.readStringUntil('\n');
    cmd.trim();
    cmd.toUpperCase();
    uint8_t emo = EMO_NONE;
    if      (cmd == "HAPPY")    emo = EMO_HAPPY;
    else if (cmd == "SAD")      emo = EMO_SAD;
    else if (cmd == "ANGRY")    emo = EMO_ANGRY;
    else if (cmd == "SURPRISE") emo = EMO_SURPRISE;
    else if (cmd == "CALM")     emo = EMO_CALM;
    else if (cmd == "FEAR")     emo = EMO_FEAR;
    else if (cmd == "DISGUST")  emo = EMO_DISGUST;
    else if (cmd == "NEUTRAL")  emo = EMO_NEUTRAL;   // ← add
    if (emo != EMO_NONE) applyEmotion(emo);
  }
}
