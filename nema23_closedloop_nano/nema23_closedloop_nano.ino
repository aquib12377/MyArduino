/*
 * ============================================================================
 *  NEMA 23 Closed-Loop Stepper Controller  (Arduino Nano / ATmega328P)
 * ----------------------------------------------------------------------------
 *  4x4 Keypad + 20×4 LCD I2C (LiquidCrystal_I2C) + STEP/DIR/ENA closed-loop drv
 *
 *  - Enter a target step count on the keypad, press '#' to run.
 *  - LCD shows: current steps completed / total steps + progress bar + state.
 *  - Pulses are generated by FastAccelStepper using hardware Timer1, so the
 *    LCD I2C redraw NEVER stalls the step train (no following-error jerk).
 *
 *  WHY THESE CHOICES ON THE NANO
 *    * FastAccelStepper on ATmega328P uses Timer1 -> STEP pin MUST be D9 or D10.
 *      (We use D9 = OC1A.) Timer1 is consumed: analogWrite() on D9/D10 and the
 *      standard Servo library are NOT available alongside this.
 *    * 20×4 LCD I2C (PCF8574 backpack) uses only ~36 bytes of object RAM vs
 *      ~128 bytes for a U8g2 one-page OLED buffer — a net RAM saving on the Nano.
 *      A 16×2 module also works; set LCD_COLS=16 / LCD_ROWS=2 and adapt renderLCD().
 *    * renderLCD() overwrites each field in place with fixed-width formatting —
 *      no lcd.clear() calls during operation, so there is zero flicker.
 *    * Nano is 5V logic -> drives the driver's 5V opto inputs directly. No level
 *      shifter needed (unlike the 3.3V ESP32 version).
 *
 *  KEYPAD MAP
 *    0-9 : enter target step count
 *    '#' : confirm + START run
 *    '*' : backspace
 *    'A' : toggle direction (only when stopped)
 *    'B' : pause / resume
 *    'C' : abort -> IDLE, position reset
 *    'D' : enable / disable driver
 *
 *  WIRING (5V opto inputs, common-anode recommended)
 *    PUL+  DIR+  ENA+   -> +5V
 *    PUL-  -> D9 (STEP)      DIR-  -> D8 (DIR)      ENA-  -> D7 (ENA, optional)
 *    Add ~1k series resistor per line if the driver opto has no built-in one.
 *    Driver logic supply ground MUST be common with the Nano ground.
 *    NEMA 23 motor power = separate 24-48V supply.
 *
 *  PIN MAP (Nano)
 *    STEP D9 | DIR D8 | ENA D7 | ALM D6
 *    Keypad rows D2 D3 D4 D5 | cols A0 A1 A2 A3
 *    LCD   SDA A4 | SCL A5  (fixed hardware I2C)   Serial on D0/D1
 *
 *  LCD 20×4 DISPLAY LAYOUT
 *    Col: 0         1
 *         01234567890123456789
 *    R 0: "NEMA23-CL FWD    EN"  <- direction + enable indicator
 *    R 1: "State : RUNNING     " <- state machine label (padded to clear stale text)
 *    R 2: "D:  5000 T: 99999_  " <- done / total (6-char right-justified), edit cursor
 *    R 3: "[################  ]" <- progress bar (18 inner cols, custom filled block)
 *
 *  If you use a 16×2 LCD:
 *    Set LCD_COLS=16, LCD_ROWS=2, and rework renderLCD() to a 2-row layout.
 *    Suggested 16×2 rows:
 *      R 0: "FWD RUNNING      EN"  (trim as needed)
 *      R 1: "D:999999 T:999999_"
 *
 *  LCD I2C address: most PCF8574 backpacks ship as 0x27 or 0x3F.
 *    If the display is blank after wiring, change LCD_I2C_ADDR to 0x3F.
 *
 *  Required libraries (Library Manager):
 *    - FastAccelStepper   (by gin66)
 *    - Keypad             (by Mark Stanley, Alexander Brevig)
 *    - LiquidCrystal I2C  (by Frank de Brabander)
 *
 *  Board: Arduino Nano (ATmega328P)
 * ============================================================================
 */

#include <LiquidCrystal_I2C.h>
#include <Wire.h>
#include <Keypad.h>
#include "FastAccelStepper.h"

// ===========================================================================
//  CONFIGURATION
// ===========================================================================
#define FW_VERSION  "1.0.0-nano"
#define SERIAL_BAUD 115200

// ---- Stepper driver pins ----
constexpr uint8_t STEP_PIN = 9;    // MUST be 9 or 10 on the Nano (Timer1)
constexpr uint8_t DIR_PIN  = 8;
constexpr uint8_t ENA_PIN  = 7;    // optional

constexpr bool USE_ENABLE_PIN    = true;   // false if ENA is not wired
constexpr bool ENABLE_ACTIVE_LOW = true;   // verify against YOUR driver datasheet

// ---- Alarm / fault feedback (optional) ----
constexpr bool     USE_ALARM_PIN    = false; // set true once ALM is wired
constexpr uint8_t  ALM_PIN          = 6;
constexpr uint8_t  ALM_ACTIVE_LEVEL = LOW;   // most ALM outputs pull LOW on fault
constexpr uint32_t ALM_DEBOUNCE_MS  = 30;

// ---- Motion profile ----
constexpr uint32_t STEPS_PER_REV    = 3200;   // = your driver microstep setting
constexpr uint32_t MAX_SPEED_SPS    = 8000;   // steps/s
constexpr uint32_t ACCELERATION     = 16000;  // steps/s^2
constexpr uint32_t MAX_TARGET_STEPS = 999999UL;

// ---- Keypad (4x4) ----
constexpr uint8_t KP_ROWS = 4;
constexpr uint8_t KP_COLS = 4;
char keymap[KP_ROWS][KP_COLS] = {
  { '1', '2', '3', 'A' },
  { '4', '5', '6', 'B' },
  { '7', '8', '9', 'C' },
  { '*', '0', '#', 'D' }
};
byte rowPins[KP_ROWS] = { 2, 3, 4, 5 };
byte colPins[KP_COLS] = { A3, A2, A1, A0 };

// ---- LCD I2C ----
// Common PCF8574 backpack addresses: 0x27 (A2A1A0=HHH) or 0x3F (A2A1A0=LLL).
// If the display is blank, swap to the other address.
constexpr uint8_t  LCD_I2C_ADDR  = 0x27;
constexpr uint8_t  LCD_COLS      = 20;   // change to 16 for a 16×2 module
constexpr uint8_t  LCD_ROWS      = 4;    // change to  2 for a 16×2 module
constexpr uint8_t  LCD_BAR_INNER = LCD_COLS - 2;  // inner chars of the progress bar

// ---- LCD refresh rate ----
constexpr uint32_t LCD_REFRESH_MS = 120;   // ~8 Hz; step train is hardware-timed

// ===========================================================================
//  GLOBAL OBJECTS
// ===========================================================================
LiquidCrystal_I2C lcd(LCD_I2C_ADDR, LCD_COLS, LCD_ROWS);

Keypad keypad(makeKeymap(keymap), rowPins, colPins, KP_ROWS, KP_COLS);

FastAccelStepperEngine engine = FastAccelStepperEngine();
FastAccelStepper* stepper = nullptr;

// ===========================================================================
//  STATE MACHINE
// ===========================================================================
enum class State : uint8_t { IDLE, RUNNING, PAUSED, DONE, FAULT };
State state = State::IDLE;

bool     dirForward    = true;
bool     driverEnabled = false;
uint32_t targetSteps   = 0;
uint32_t entryValue    = 0;
bool     entryActive   = false;

uint32_t lastLcdMs  = 0;
bool     lcdDirty   = true;

int      almLastRaw      = HIGH;
uint32_t almLastChangeMs = 0;
bool     almLatched      = false;

// ===========================================================================
//  HELPERS
// ===========================================================================
const __FlashStringHelper* stateName(State s) {
  switch (s) {
    case State::IDLE:    return F("IDLE");
    case State::RUNNING: return F("RUNNING");
    case State::PAUSED:  return F("PAUSED");
    case State::DONE:    return F("DONE");
    case State::FAULT:   return F("FAULT");
  }
  return F("?");
}

// Returns the printed character count of stateName(s).
// Avoids strlen_P on a __FlashStringHelper pointer; keeps all state info in one place.
static uint8_t stateNameLen(State s) {
  switch (s) {
    case State::IDLE:    return 4;
    case State::RUNNING: return 7;
    case State::PAUSED:  return 6;
    case State::DONE:    return 4;
    case State::FAULT:   return 5;
    default:             return 1; // "?"
  }
}

void setState(State s) {
  if (s == state) return;
  state = s;
  lcdDirty = true;
  Serial.print(F("[STATE] -> ")); Serial.println(stateName(s));
}

uint32_t completedSteps() {
  if (!stepper) return 0;
  long pos = stepper->getCurrentPosition();
  return (uint32_t)(pos < 0 ? -pos : pos);
}

// ===========================================================================
//  DRIVER CONTROL
// ===========================================================================
void setDriverEnabled(bool en) {
  driverEnabled = en;
  if (USE_ENABLE_PIN && stepper) {
    if (en) stepper->enableOutputs();
    else    stepper->disableOutputs();
  }
  Serial.print(F("[INFO] Driver enabled: ")); Serial.println(en ? F("YES") : F("NO"));
  lcdDirty = true;
}

void startRun() {
  if (targetSteps == 0)            { Serial.println(F("[WARN] Start ignored: target 0")); return; }
  if (USE_ALARM_PIN && almLatched) { Serial.println(F("[WARN] Start blocked: alarm latched")); return; }
  setDriverEnabled(true);
  stepper->setCurrentPosition(0);
  long target = dirForward ? (long)targetSteps : -(long)targetSteps;
  stepper->moveTo(target);
  setState(State::RUNNING);
  Serial.print(F("[INFO] Run start, target=")); Serial.print(targetSteps);
  Serial.print(F(" dir=")); Serial.println(dirForward ? F("FWD") : F("REV"));
}

void pauseRun() {
  if (state != State::RUNNING) return;
  stepper->stopMove();              // controlled decel to stop
  setState(State::PAUSED);
}

void resumeRun() {
  if (state != State::PAUSED) return;
  long target = dirForward ? (long)targetSteps : -(long)targetSteps;
  stepper->moveTo(target);
  setState(State::RUNNING);
}

void abortRun() {
  if (stepper) stepper->forceStopAndNewPosition(0);
  entryValue  = 0;
  entryActive = false;
  almLatched  = false;              // re-arm after user-acknowledged stop
  setState(State::IDLE);
  Serial.println(F("[INFO] Aborted, position reset"));
}

// ===========================================================================
//  KEYPAD HANDLING
// ===========================================================================
void applyDigit(char c) {
  if (state == State::RUNNING || state == State::PAUSED) {
    Serial.println(F("[WARN] Cannot edit target while run active")); return;
  }
  if (!entryActive) { entryValue = 0; entryActive = true; if (state != State::IDLE) setState(State::IDLE); }
  uint32_t next = entryValue * 10UL + (uint32_t)(c - '0');
  if (next > MAX_TARGET_STEPS) { Serial.println(F("[WARN] Target exceeds max")); return; }
  entryValue = next;
  lcdDirty   = true;
}

void backspace() {
  if (state == State::RUNNING || state == State::PAUSED) return;
  entryValue /= 10UL;
  if (entryValue == 0) entryActive = false;
  if (state != State::IDLE) setState(State::IDLE);
  lcdDirty = true;
}

void toggleDirection() {
  if (state == State::RUNNING || state == State::PAUSED) {
    Serial.println(F("[WARN] Direction change blocked while moving")); return;
  }
  dirForward = !dirForward;
  Serial.print(F("[INFO] Direction: ")); Serial.println(dirForward ? F("FWD") : F("REV"));
  lcdDirty = true;
}

void handleKey(char k) {
  switch (k) {
    case '0': case '1': case '2': case '3': case '4':
    case '5': case '6': case '7': case '8': case '9':
      applyDigit(k); break;

    case '#':
      if (state == State::IDLE || state == State::DONE) {
        if (entryActive && entryValue > 0) targetSteps = entryValue;
        entryActive = false;
        startRun();
      }
      break;

    case '*': backspace(); break;
    case 'A': toggleDirection(); break;

    case 'B':
      if      (state == State::RUNNING) pauseRun();
      else if (state == State::PAUSED)  resumeRun();
      break;

    case 'C': abortRun(); break;

    case 'D':
      if (state != State::RUNNING) setDriverEnabled(!driverEnabled);
      else Serial.println(F("[WARN] Disable blocked while running"));
      break;
  }
}

// ===========================================================================
//  ALARM MONITOR (optional, debounced)
// ===========================================================================
void checkAlarm() {
  if (!USE_ALARM_PIN) return;
  int raw = digitalRead(ALM_PIN);
  uint32_t now = millis();
  if (raw != almLastRaw) { almLastRaw = raw; almLastChangeMs = now; }
  if ((now - almLastChangeMs) >= ALM_DEBOUNCE_MS) {
    if (raw == ALM_ACTIVE_LEVEL && !almLatched) {
      almLatched = true;
      if (stepper) stepper->forceStop();
      setDriverEnabled(false);
      setState(State::FAULT);
      Serial.println(F("[ERROR] Driver ALARM asserted - halted"));
    }
  }
}

// ===========================================================================
//  LCD RENDERING
// ---------------------------------------------------------------------------
//  Layout (20 columns × 4 rows):
//
//    Col: 0         1
//         01234567890123456789
//    R 0: "NEMA23-CL FWD    EN"  direction + enable indicator   (19 of 20 cols used)
//    R 1: "State : RUNNING     " state label, space-padded to 20 to erase stale text
//    R 2: "D:  5000 T: 99999_  " done/total, 6-char right-justified; '_' = editing mode
//    R 3: "[################  ]" progress bar, 18 inner cols; char 0 = solid block
//
//  Strategy: all fields are written at fixed cursor positions with fixed field widths.
//  No lcd.clear() is ever called after the boot splash, so there is zero flicker.
//  Fixed-width %6lu fields naturally erase shorter previous values.
// ===========================================================================
void renderLCD() {
  // ---- Snapshot all volatile state before drawing ----
  uint32_t done      = completedSteps();
  bool     editing   = (state == State::IDLE && entryActive);
  uint32_t showTotal = editing ? entryValue : targetSteps;

  // ---- Row 0: "NEMA23-CL FWD    EN" ----
  // Breakdown: "NEMA23-CL "(10) + "FWD"/"REV"(3) + "    "(4) + "EN"/"--"(2) = 19 chars
  lcd.setCursor(0, 0);
  lcd.print(F("NEMA23-CL "));
  lcd.print(dirForward ? F("FWD") : F("REV"));
  lcd.print(F("    "));
  lcd.print(driverEnabled ? F("EN") : F("--"));

  // ---- Row 1: "State : RUNNING     " ----
  // "State : "(8) + state name (4-7) + spaces to fill column 20
  lcd.setCursor(0, 1);
  lcd.print(F("State : "));
  lcd.print(stateName(state));
  uint8_t slen = stateNameLen(state);
  for (uint8_t i = slen; i < (LCD_COLS - 8); i++) lcd.print(' ');

  // ---- Row 2: "D:  5000 T: 99999_ " ----
  // "D:"(2) + %6lu(6) + " T:"(3) + %6lu(6) + edit-marker(1) + " "(1) = 19 chars
  {
    char buf[21];
    snprintf_P(buf, sizeof(buf), PSTR("D:%6lu T:%6lu%c "),
               (unsigned long)done,
               (unsigned long)showTotal,
               editing ? '_' : ' ');
    lcd.setCursor(0, 2);
    lcd.print(buf);
  }

  // ---- Row 3: "[###########       ]" ----
  // 1 '[' + LCD_BAR_INNER chars (filled or space) + 1 ']'
  // Custom char 0 (solid filled block) is used for the filled portion.
  // Progress calculation: integer-divide to avoid 32-bit overflow on small targets.
  uint8_t fillW = 0;
  if (!editing) {
    if (state == State::DONE) {
      fillW = LCD_BAR_INNER;          // full bar when run completes
    } else if (targetSteps > 0) {
      uint32_t capped = (done > targetSteps) ? targetSteps : done;
      uint32_t f = (uint32_t)LCD_BAR_INNER * capped / targetSteps;
      fillW = (f > LCD_BAR_INNER) ? LCD_BAR_INNER : (uint8_t)f;
    }
  }
  lcd.setCursor(0, 3);
  lcd.print('[');
  for (uint8_t i = 0; i < LCD_BAR_INNER; i++) {
    // lcd.write((uint8_t)0) prints custom char 0 (solid block); avoids '\0' string-termination pitfall
    lcd.write(i < fillW ? (uint8_t)0 : ' ');
  }
  lcd.print(']');
}

// ===========================================================================
//  SETUP
// ===========================================================================
void setup() {
  Serial.begin(SERIAL_BAUD);
  delay(150);
  Serial.println();
  Serial.println(F("============================================"));
  Serial.print  (F("[BOOT] NEMA23-CL-Controller (Nano) v")); Serial.println(F(FW_VERSION));
  Serial.print  (F("[BOOT] Baud: "));      Serial.println(SERIAL_BAUD);
  Serial.print  (F("[BOOT] Steps/rev: ")); Serial.println(STEPS_PER_REV);
  Serial.print  (F("[BOOT] MaxSpeed: "));  Serial.print(MAX_SPEED_SPS);  Serial.println(F(" sps"));
  Serial.print  (F("[BOOT] Accel: "));     Serial.print(ACCELERATION);   Serial.println(F(" sps^2"));
  Serial.print  (F("[BOOT] Free RAM: "));  Serial.println(freeRam());
  Serial.println(F("============================================"));

  // ---- LCD init ----
  // lcd.init() resets the controller, lcd.backlight() enables the backlight transistor.
  // createChar() MUST be called after init(); the CGRAM is volatile — always reload on boot.
  // Custom char 0: solid filled block for the progress bar (all 5 col bits set per row).
  lcd.begin();
  lcd.backlight();
  {
    uint8_t blockChar[8] = { 0xFF, 0xFF, 0xFF, 0xFF, 0xFF, 0xFF, 0xFF, 0xFF };
    lcd.createChar(0, blockChar);
  }
  Serial.print(F("[INIT] LCD "));
  Serial.print(LCD_COLS); Serial.print('x'); Serial.println(LCD_ROWS);

  // Boot splash — lcd.clear() is used only here; renderLCD() never calls it
  lcd.clear();
  lcd.setCursor(0, 0); lcd.print(F("NEMA23-CL Nano"));
  lcd.setCursor(0, 1); lcd.print(F("v")); lcd.print(F(FW_VERSION));
  lcd.setCursor(0, 2); lcd.print(F("Booting..."));
  delay(600);

  // ---- Alarm pin (5V AVR: internal pull-up for active-low open-collector ALM) ----
  if (USE_ALARM_PIN) {
    pinMode(ALM_PIN, (ALM_ACTIVE_LEVEL == LOW) ? INPUT_PULLUP : INPUT);
    almLastRaw = digitalRead(ALM_PIN);
    Serial.println(F("[INIT] Alarm monitor enabled"));
  }

  // ---- Stepper (Timer1; STEP must be D9 or D10) ----
  engine.init();
  stepper = engine.stepperConnectToPin(STEP_PIN);
  if (!stepper) {
    Serial.println(F("[ERROR] Stepper attach FAILED - STEP must be D9/D10. HALT"));
    setState(State::FAULT);
    lcd.clear();
    lcd.setCursor(0, 0); lcd.print(F("STEPPER INIT FAIL!"));
    lcd.setCursor(0, 1); lcd.print(F("STEP=D9 or D10 only"));
    lcd.setCursor(0, 2); lcd.print(F("Check STEP_PIN cfg"));
    lcd.setCursor(0, 3); lcd.print(F("System halted."));
    return;   // hang in fault; loop() will not execute meaningful code
  }

  stepper->setDirectionPin(DIR_PIN);
  if (USE_ENABLE_PIN) {
    stepper->setEnablePin(ENA_PIN, ENABLE_ACTIVE_LOW);
    stepper->setAutoEnable(false);
  }
  stepper->setSpeedInHz(MAX_SPEED_SPS);
  stepper->setAcceleration(ACCELERATION);
  stepper->setCurrentPosition(0);
  Serial.println(F("[INIT] FastAccelStepper OK"));

  setDriverEnabled(false);   // motor released at boot
  setState(State::IDLE);
  Serial.println(F("[INFO] Ready. Enter steps + '#'. A=dir B=pause C=abort D=enable"));
}

// ===========================================================================
//  LOOP
// ===========================================================================
void loop() {
  char k = keypad.getKey();
  if (k) handleKey(k);

  checkAlarm();

  // Detect natural end-of-move
  if (state == State::RUNNING && stepper && !stepper->isRunning()) {
    setState(State::DONE);
    Serial.println(F("[INFO] Run complete"));
  }

  // Redraw on state change (lcdDirty) OR on periodic tick — whichever comes first
  uint32_t now = millis();
  bool periodic = (now - lastLcdMs) >= LCD_REFRESH_MS;
  if (lcdDirty || periodic) {
    renderLCD();
    lastLcdMs = now;
    lcdDirty  = false;
  }
}

// ===========================================================================
//  Free-RAM probe (boot diagnostic)
// ===========================================================================
int freeRam() {
  extern int __heap_start, *__brkval;
  int v;
  return (int)&v - (__brkval == 0 ? (int)&__heap_start : (int)__brkval);
}
